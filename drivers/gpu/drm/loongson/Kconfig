## drivers/gpu/drm/loongson/Kconfig
```kconfig
config DRM_LOONGSON
	tristate "DRM support for LS7A Display Controller"
	depends on DRM && PCI
	select FB_CFB_FILLRECT
	select FB_CFB_COPYAREA
	select FB_CFB_IMAGEBLIT
	select DRM_KMS_HELPER
	select DRM_KMS_FB_HELPER
	select DRM_GEM_DMA_HELPER
	default n
	help
	  Support the display controllers found on the Loongson's LS7A
	  bridge.

	  This driver provides no built-in acceleration; acceleration is
	  performed by Vivante GC1000. This driver provides kernel mode
	  setting and buffer management to userspace.
```
